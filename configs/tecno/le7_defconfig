## configs/tecno/le7_defconfig
```kconfig
CONFIG_TECNO_LE7=y
CONFIG_MEDIATEK_MT6768=y
CONFIG_THREAD_SUPPORT=y
CONFIG_STAGE1_SUPPORT=y
CONFIG_LEGACY_LK=n
CONFIG_BOOTLOADER_BASE=0x4C400000
CONFIG_BOOTLOADER_SIZE=0xF7FDC
CONFIG_DPRINTF_ADDRESS=0x4C432434
CONFIG_APP_CALLER=0x4C42342C
CONFIG_APP_ADDRESS=0x4c425e50
CONFIG_BOOTMODE_ADDRESS=0x4c4FA524
CONFIG_PLATFORM_INIT_CALLER=0x4c421d04
CONFIG_PLATFORM_INIT_ADDRESS=0x4C402710
CONFIG_FASTBOOT_FAIL_ADDRESS=0x4c4267f4
CONFIG_FASTBOOT_INFO_ADDRESS=0x4C426774
CONFIG_FASTBOOT_OKAY_ADDRESS=0x4c427000
CONFIG_FASTBOOT_PUBLISH_ADDRESS=0x4C426400
CONFIG_FASTBOOT_REGISTER_ADDRESS=0x4C4263C4
CONFIG_LK_LOG_STORE_ADDRESS=0x4C44592C
CONFIG_MTK_DETECT_KEY_ADDRESS=0x4c404550
CONFIG_VIDEO_PRINTF_ADDRESS=0x4C432014
CONFIG_THREAD_CREATE_ADDRESS=0x4C422544
CONFIG_THREAD_RESUME_ADDRESS=0x4C422758
CONFIG_FREE_ADDRESS=0x4C432864
CONFIG_INIT_STORAGE_CALLER=0x4C40273E
CONFIG_INIT_STORAGE_ADDRESS=0x4c402524
CONFIG_MALLOC_ADDRESS=0x4C433130
CONFIG_SPOOF_SUPPORT=y
CONFIG_PARTITION_GET_SIZE_BY_NAME_ADDRESS=0x4c44bb84
CONFIG_PARTITION_READ_ADDRESS=0x4c44d654
CONFIG_SET_ENV_ADDRESS=0x4c44c62c
CONFIG_GET_ENV_ADDRESS=0x4c44c3a8
CONFIG_ENVIRONMENT_SUPPORT=y
```
